/ {
    underglow {
        compatible = "zmk,rgb-underglow";
        label = "RGB Underglow";
        color-order = "GRB";
        chain-length = <12>;                 // Adjust if you add per-key later
        io-channels = <&adc 0>;
        pin = <&gpio0 6 GPIO_ACTIVE_HIGH>;   // nice!nano TX pin = P0.06
        brightness = <120>;
        sleep = <1>;
    };
};
